#define ZMK_BASE_LAYER(name, LT, RT, LM, RM, LB, RB, LH, RH)                   \
    ZMK_LAYER(                                                                 \
        name,                                                                  \
                 LT RT                                                         \
                 LM RM                                                         \
                 LB RB                                                         \
        &none &none &kp LGUI LH RH &smart_mouse &none &none                    \
    )

#include "4x10.h"
#include "base.keymap"
