## config/boards/shields/charybdis_v2/Kconfig.shield
```kconfig
config SHIELD_CHARYBDIS_V2_DONGLE
    def_bool $(shields_list_contains,charybdis_v2_dongle)

config SHIELD_CHARYBDIS_V2_LEFT
	def_bool $(shields_list_contains,charybdis_v2_left)

config SHIELD_CHARYBDIS_V2_RIGHT
	def_bool $(shields_list_contains,charybdis_v2_right)
```
