## config/boards/shields/charybdis_dongle/Kconfig.defconfig
```kconfig
if SHIELD_CHARYBDIS_DONGLE

# Max 16 characters in keyboard name
config ZMK_KEYBOARD_NAME
    default "Charybdis Nano"

config ZMK_SPLIT_ROLE_CENTRAL
    default y

# # Set this to the number of peripherals your dongle will have.
# # For a unibody, this would be 1. If you have left and right halves, set it to 2, etc.
config ZMK_SPLIT_BLE_CENTRAL_PERIPHERALS
    default 2

# # Set this to ZMK_SPLIT_BLE_CENTRAL_PERIPHERALS + your desired number of BT profiles (default is 5)
config BT_MAX_CONN
    default 6

# # Set this to the same number as BT_MAX_CONN
config BT_MAX_PAIRED
    default 6

# config ZMK_POINTING
#     default y

# config SPI
#     default y

# config ST7789V
#     default y

endif

if ZMK_DISPLAY

config I2C
    default y

config SSD1306
    default y

choice ZMK_DISPLAY_WORK_QUEUE
    default ZMK_DISPLAY_WORK_QUEUE_DEDICATED
endchoice

# choice ST7789V_PIXEL_FORMAT
#     default ST7789V_RGB565
# endchoice

endif

if LVGL

config LV_Z_VDB_SIZE
    default 64

config LV_DPI_DEF
    default 148

config LV_Z_BITS_PER_PIXEL
    default 1

choice LV_COLOR_DEPTH
    default LV_COLOR_DEPTH_1
endchoice

endif

if SHIELD_CHARYBDIS_DONGLE_LEFT || SHIELD_CHARYBDIS_DONGLE_RIGHT || SHIELD_CHARYBDIS_DONGLE

config ZMK_SPLIT
    default y

endif
```

## config/boards/shields/charybdis_dongle/Kconfig.shield
```kconfig
config SHIELD_CHARYBDIS_DONGLE
    def_bool $(shields_list_contains,charybdis_dongle)

config SHIELD_CHARYBDIS_DONGLE_LEFT
	def_bool $(shields_list_contains,charybdis_dongle_left)

config SHIELD_CHARYBDIS_DONGLE_RIGHT
	def_bool $(shields_list_contains,charybdis_dongle_right)
```

## config/boards/shields/corne/Kconfig.shield
```kconfig
config SHIELD_CORNE_LEFT_V2
    def_bool $(shields_list_contains,corne_left_v2)

config SHIELD_CORNE_RIGHT_V2
    def_bool $(shields_list_contains,corne_right_v2)
```

## config/boards/shields/keezyboost/Kconfig.defconfig
```kconfig
# Copyright (c) 2022 The ZMK Contributors
# SPDX-License-Identifier: MIT

if SHIELD_KEEZYBOOST

config ZMK_KEYBOARD_NAME
    default "keezyboost"

if ZMK_DISPLAY

config SPI
    default y

config ST7735R
    default y

endif # ZMK_DISPLAY

endif
```

## config/boards/shields/keezyboost/Kconfig.shield
```kconfig
# Copyright (c) 2022 The ZMK Contributors
# SPDX-License-Identifier: MIT

config SHIELD_KEEZYBOOST
    def_bool $(shields_list_contains,keezyboost)
```
